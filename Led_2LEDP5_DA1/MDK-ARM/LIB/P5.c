#include "P5.h"

int dosang;

extern TIM_HandleTypeDef htim2;
extern unsigned char loaiLED;

const uint16_t scan_PWM_duty[]={2,4,8,16,32,64,128,256,512,1024};   //he so chia nap vao time pwm chan OE
unsigned int timer_clock[8]={18,36,72,144,288,575};                 // he so chia nap vao timer

unsigned char vitri_bit=0; // kiem tra xem dang quet den bit nao
unsigned char hang_led;
uint8_t Buffer_GPIO[SCAN_TYPE*MAX_BIT*128];
unsigned char Buffer_RGB[3*32*128]=
{
//[64x64]  (C) 2023 by PhamNghia_PhanAnhCuong
//Red 
0x01E,0x01E,0x01F,0x01F,0x01E,0x01E,0x01F,0x01F,0x01F,0x01F,0x01E,0x01F,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0x01F,
//Green 
0x01F,0x01F,0x01F,0x01F,0x01F,0x01F,0x01F,0x01F,0x01F,0x01F,0x01E,0x01F,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0x01F,
//Blue 
0x01F,0x01E,0x01E,0x01E,0x01F,0x01F,0x01F,0x01F,0x01F,0x01F,0x01F,0x01F,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0x01F,

};
#define arrD1 (32*128)
#define arrD2 (128)



//---------------------------------Chuong trinh quet LED ma tran --------------------------------------------------------//
const unsigned char scan_data[SCAN_TYPE]=
{
	  0,8,4,12, 2,10,6,14, 1,9,5,13, 3,11,7,15,
};
void scan16S(char so)
{
	switch(so)
	{
		case 0: Control_P->BSRR= A_RSET|B_RSET|C_RSET|D_RSET;  return;
		case 1: Control_P->BSRR= A_RSET|B_RSET|C_RSET|D_SSET;  return;
		case 2: Control_P->BSRR= A_RSET|B_RSET|C_SSET|D_RSET;  return;
		case 3: Control_P->BSRR= A_RSET|B_RSET|C_SSET|D_SSET;  return;
		case 4: Control_P->BSRR= A_RSET|B_SSET|C_RSET|D_RSET;  return;
		case 5: Control_P->BSRR= A_RSET|B_SSET|C_RSET|D_SSET;  return;
		case 6: Control_P->BSRR= A_RSET|B_SSET|C_SSET|D_RSET;  return;
		case 7: Control_P->BSRR= A_RSET|B_SSET|C_SSET|D_SSET;  return;
		case 8: Control_P->BSRR= A_SSET|B_RSET|C_RSET|D_RSET;  return;
		case 9: Control_P->BSRR= A_SSET|B_RSET|C_RSET|D_SSET;  return;
		case 10:Control_P->BSRR= A_SSET|B_RSET|C_SSET|D_RSET;  return;
		case 11:Control_P->BSRR= A_SSET|B_RSET|C_SSET|D_SSET;  return;
		case 12:Control_P->BSRR= A_SSET|B_SSET|C_RSET|D_RSET;  return;
		case 13:Control_P->BSRR= A_SSET|B_SSET|C_RSET|D_SSET;  return;
		case 14:Control_P->BSRR= A_SSET|B_SSET|C_SSET|D_RSET;  return;
		case 15:Control_P->BSRR= A_SSET|B_SSET|C_SSET|D_SSET;  return;
	}
}
void display(void)
{  
	  for(int hang=0;hang<SCAN_TYPE;hang++)
	  {
			uint8_t dat;
			for(int ts=0;ts<MAX_BIT;ts++)
			{
			 for(int i=0;i<128;i++)
			 {
				 dat = 0;
				 if((Buffer_RGB[1*arrD1 + (16+hang)*arrD2 + i] & (1<<ts)) != 0 ){dat|=(0x01<<G2);} //ghi bit 7 G2 
				 if((Buffer_RGB[1*arrD1 + (0+hang)*arrD2 + i]  & (1<<ts)) != 0 ){dat|=(0x01<<G1);} //ghi bit 0 G1
				 if((Buffer_RGB[0*arrD1 + (0+hang)*arrD2 + i]  & (1<<ts)) != 0 ){dat|=(0x01<<R1);} //ghi bit 1 R1
				 if((Buffer_RGB[2*arrD1 + (0+hang)*arrD2 + i]  & (1<<ts)) != 0 ){dat|=(0x01<<B1);} //ghi bit 4 B1
				 if((Buffer_RGB[0*arrD1 + (16+hang)*arrD2 + i] & (1<<ts)) != 0 ){dat|=(0x01<<R2);} //ghi bit 6 R2
				 if((Buffer_RGB[2*arrD1 + (16+hang)*arrD2 + i] & (1<<ts)) != 0 ){dat|=(0x01<<B2);} //ghi bit 9 B2
				 Buffer_GPIO[hang*MAX_BIT*128 + ts*128 + i]=dat;
			 }
			} 
		}
}
void ngatquetled(void)
{
  __HAL_TIM_SET_COMPARE(&htim2,TIM_CHANNEL_2,0);
	
  for(int i=0;i<128;i++)
	{
		data_PORT->ODR=Buffer_GPIO[scan_data[hang_led]*MAX_BIT*128 +vitri_bit*128 + i];
		clk_P->BSRR=(1<<(clk+16));clk_P->BSRR=(1<<clk);
	}	 	
		
	__HAL_TIM_SET_COMPARE(&htim2,TIM_CHANNEL_2,scan_PWM_duty[vitri_bit]);
	
	scan16S(scan_data[hang_led]);
	Control_P->BSRR=(1<<LAT); // chot data
	Control_P->BSRR=(1<<(LAT+16));
	
	vitri_bit++;
	if(vitri_bit==MAX_BIT){vitri_bit=0;hang_led++;if(hang_led==SCAN_TYPE)hang_led=0;}	
}
void SET_dosang(uint16_t sang)
{
	 dosang=sang;
}
uint16_t GET_dosang(void)
{
	 return dosang;
}

